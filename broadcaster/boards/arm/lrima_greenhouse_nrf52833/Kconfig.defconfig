## broadcaster/boards/arm/lrima_greenhouse_nrf52833/Kconfig.defconfig
```kconfig
# Copyright (c) 2023 Nordic Semiconductor ASA
# SPDX-License-Identifier: Apache-2.0

if BOARD_LRIMA_GREENHOUSE_NRF52833

config BOARD
	default "lrima_greenhouse_nrf52833"

config BT_CTLR
   default BT

endif
```

## code/broadcaster/boards/LRIMa/lrima_greenhouse_nrf52833/Kconfig
```kconfig
# LRIMa Greenhouse nRF52833 board configuration

config BOARD_LRIMA_GREENHOUSE_NRF52833
	select SOC_NRF52833_QIAA
```

## code/broadcaster/boards/LRIMa/lrima_greenhouse_nrf52833/lrima_greenhouse_nrf52833_defconfig
```kconfig
CONFIG_ARM_MPU=y
CONFIG_HW_STACK_PROTECTION=y
# Use the internal RC oscillator instead of the external one
CONFIG_CLOCK_CONTROL_NRF_K32SRC_RC=y
```

## code/broadcaster/boards/arm/lrima_greenhouse_nrf52833/Kconfig.board
```kconfig
# Copyright (c) 2023 Nordic Semiconductor ASA
# SPDX-License-Identifier: Apache-2.0

config BOARD_LRIMA_GREENHOUSE_NRF52833
	bool "LRIMa_greenhouse_nrf52833"
	depends on SOC_NRF52833_QIAA
```

## code/broadcaster/boards/arm/lrima_greenhouse_nrf52833/lrima_greenhouse_nrf52833_defconfig
```kconfig
# Copyright (c) 2023 Nordic Semiconductor ASA
# SPDX-License-Identifier: Apache-2.0

CONFIG_SOC_SERIES_NRF52X=y
CONFIG_SOC_NRF52833_QIAA=y
CONFIG_BOARD_LRIMA_GREENHOUSE_NRF52833=y

# Enable MPU
CONFIG_ARM_MPU=y

# Enable hardware stack protection
CONFIG_HW_STACK_PROTECTION=y

# Enable GPIO
CONFIG_GPIO=y

# Enable pin reset
CONFIG_GPIO_AS_PINRESET=y

# Enable ADC support #
CONFIG_ADC=y
CONFIG_ADC_ASYNC=y

# Enable i2c support #
CONFIG_I2C=y

# Low power config
CONFIG_PM=y
CONFIG_PM_DEVICE=y
CONFIG_PM_DEVICE_RUNTIME=y

# Enable RTT
CONFIG_USE_SEGGER_RTT=y
CONFIG_RTT_CONSOLE=y
CONFIG_CONSOLE=y

# Enable pin control
CONFIG_PINCTRL=y

# Enbable clock control support #
CONFIG_CLOCK_CONTROL_NRF_K32SRC_RC=y

# Enable Bluetooth and its dependencies
CONFIG_BT=y
CONFIG_BT_EXT_ADV=y
CONFIG_BT_EXT_ADV_MAX_ADV_SET=2
CONFIG_BT_PERIPHERAL=y
CONFIG_BT_BROADCASTER=y
CONFIG_BT_GATT_CLIENT=y
CONFIG_BT_GATT_DM=y
CONFIG_BT_GATT_DYNAMIC_DB=y
CONFIG_BT_DEVICE_NAME_DYNAMIC=y
CONFIG_BT_ID_MAX=2
```
